## Kconfig
```kconfig
menuconfig ZMK_COM
	bool "Enable zmk-com companion communication"
	default n
	depends on RAW_HID && ZMK_RGB_UNDERGLOW
	help
	  Enables the in-repo companion transport module that publishes active
	  layer reports and accepts RGB underglow commands over Raw HID.
```

## config/west.yml
```yaml
manifest:
  remotes:
    - name: zmkfirmware
      url-base: https://github.com/zmkfirmware
    - name: zzeneg
      url-base: https://github.com/zzeneg
      # Additional modules containing boards/shields/custom code can be listed here as well.
      # See:
      # - https://zmk.dev/docs/features/modules
      # - https://docs.zephyrproject.org/3.5.0/develop/west/manifest.html#projects
  #  - name: gpeye
  #    url-base: https://github.com/GPeye
  projects:
   # - name: mario-peripheral-animation
   #   remote: gpeye
   #    revision: main 
    - name: eyelash_sofle
      url: https://github.com/a741725193/zmk-sofle
      revision: main
    - name: zmk
      remote: zmkfirmware
      revision: v0.3.0
      import: app/west.yml
    - name: zmk-raw-hid
      remote: zzeneg
      revision: e25e325adc90fccb60cc08393b8c2b0ba6d647c7
  self:
    path: boards
```
